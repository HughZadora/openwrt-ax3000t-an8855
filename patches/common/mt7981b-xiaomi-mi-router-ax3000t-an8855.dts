// SPDX-License-Identifier: GPL-2.0-or-later OR MIT

/dts-v1/;
#include "mt7981b-xiaomi-mi-router-ax3000t.dtsi"

/ {
	model = "Xiaomi Mi Router AX3000T (AN8855)";
	compatible = "xiaomi,mi-router-ax3000t-an8855", "mediatek,mt7981";
};

&spi_nand {
	mediatek,nmbm;
	mediatek,bmt-max-ratio = <1>;
	mediatek,bmt-max-reserved-blocks = <64>;
	mediatek,bmt-mtd-overridden-oobsize = <64>;
};

&partitions {
	/* single UBI, layout matches the retail U-Boot of the
	 * AN8855 external-switch hardware revision.
	 */
	partition@600000 {
		label = "ubi";
		reg = <0x600000 0x7000000>;
	};
};